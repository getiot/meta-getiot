## conf/layer.conf
```bitbake
# We have a conf and classes directory, add to BBPATH
BBPATH .= ":${LAYERDIR}"

# We have recipes-* directories, add to BBFILES
BBFILES += "${LAYERDIR}/recipes-*/*/*.bb \
            ${LAYERDIR}/recipes-*/*/*.bbappend"

BBFILE_COLLECTIONS += "meta-getiot"
BBFILE_PATTERN_meta-getiot = "^${LAYERDIR}/"
BBFILE_PRIORITY_meta-getiot = "6"

LAYERDEPENDS_meta-getiot = "core"
LAYERSERIES_COMPAT_meta-getiot = "warrior zeus"
```
